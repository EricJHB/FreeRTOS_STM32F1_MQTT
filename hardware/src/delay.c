/**
	************************************************************
	************************************************************
	************************************************************
	*	文件名： 	delay.c
	*
	*	作者： 		张继瑞
	*
	*	日期： 		2017-01-23
	*
	*	版本： 		V1.0
	*
	*	说明： 		利用Timer6做阻塞式延时
	*
	*	修改记录：	
	************************************************************
	************************************************************
	************************************************************
**/

//单片机头文件
#include "stm32f10x.h"

//delay头文件
#include "delay.h"



//延时系数
unsigned char UsCount = 0;
unsigned short MsCount = 0;



/*
************************************************************
*	函数名称：	Delay_Init
*
*	函数功能：	systick初始化
*
*	入口参数：	无
*
*	返回参数：	无
*
*	说明：		
************************************************************
*/
void Delay_Init(void)
{

	RCC_APB1PeriphClockCmd(RCC_APB1Periph_TIM6, ENABLE);

	TIM6->CR1 |= 1UL << 3;									//单脉冲模式
	
	TIM6->EGR |= 1;											//更新生成
	
	TIM6->DIER = 0;											//禁止所有中断
	
	TIM6->CR1 &= (unsigned short)~TIM_CR1_CEN;				//停止计时

}

/*
************************************************************
*	函数名称：	DelayUs
*
*	函数功能：	微秒级延时
*
*	入口参数：	us：延时的时长
*
*	返回参数：	无
*
*	说明：		此时钟(21MHz)最大延时798915us
************************************************************
*/
void DelayUs(unsigned short us)
{

	TIM6->ARR = us;
	
	TIM6->PSC = 71;									//timer6为72MHz，设置为71+1分频，1MHz，1us计数一次
	
	TIM6->CR1 |= (unsigned short)TIM_CR1_CEN;		//开始计时
	
	while(!(TIM6->SR & 1));							//等待产生中断事件
	
	TIM6->SR &= ~(1UL << 0);						//清除标志

}

/*
************************************************************
*	函数名称：	DelayXms
*
*	函数功能：	毫秒级延时
*
*	入口参数：	ms：延时的时长
*
*	返回参数：	无
*
*	说明：		
************************************************************
*/
void DelayXms(unsigned short ms)
{

	if(ms < 32768)
	{
		TIM6->ARR = (ms << 1);						//双倍计数值
		
		TIM6->PSC = 35999;							//timer6为72MHz，设置为35999+1分频，2KHz，500us计数一次
		
		TIM6->CR1 |= (unsigned short)TIM_CR1_CEN;	//开始计时
		
		while(!(TIM6->SR & 1));						//等待产生中断事件
		
		TIM6->SR &= ~(1UL << 0);					//清除标志
	}

}

/*
************************************************************
*	函数名称：	DelayMs
*
*	函数功能：	微秒级长延时
*
*	入口参数：	ms：延时的时长
*
*	返回参数：	无
*
*	说明：		多次调用DelayXms，做到长延时
************************************************************
*/
void DelayMs(unsigned short ms)
{

	unsigned char repeat = 0;
	unsigned short remain = 0;
	
	repeat = ms / 500;
	remain = ms % 500;
	
	while(repeat)
	{
		DelayXms(500);
		repeat--;
	}
	
	if(remain)
		DelayXms(remain);

}
